## VCK190-Ethernet/2023.2/pl_4x25g_mrmac/Software/Petalinux/components/yocto/layers/meta-petalinux/conf/distro/include/petalinux-version.conf
```bitbake
# Main release version
XILINX_VER_MAIN = "2023.2"

# Set to "release" for major releases and "update-1" for update releases
XILINX_VER_UPDATE = "release"

# This will be set in local.conf for CI builds
XILINX_VER_BUILD ?= "S10121051"

# Petalinux version
PETALINUX_VERSION = "${XILINX_VER_MAIN}"
```

## VCK190-Ethernet/2023.2/pl_4x25g_mrmac/Software/Petalinux/components/yocto/layers/meta-system-controller/conf/layer.conf
```bitbake
# We have a conf and classes directory, add to BBPATH
BBPATH .= ":${LAYERDIR}"

# We have recipes-* directories, add to BBFILES
BBFILES += "${LAYERDIR}/recipes-*/*/*.bb \
            ${LAYERDIR}/recipes-*/*/*.bbappend"

BBFILES_DYNAMIC += " \
petalinux:${LAYERDIR}/meta-petalinux/recipes-*/*/*.bb \
petalinux:${LAYERDIR}/meta-petalinux/recipes-*/*/*.bbappend \
"

BBFILE_COLLECTIONS += "meta-system-controller"
BBFILE_PATTERN_meta-system-controller = "^${LAYERDIR}/"
BBFILE_PRIORITY_meta-system-controller = "6"

LAYERDEPENDS_meta-system-controller = "core xilinx"

LAYERRECOMMENDS_meta-system-controller = "xilinx-tools"

LAYERSERIES_COMPAT_meta-system-controller = "langdale"
```

## VCK190-Ethernet/2023.2/pl_4x25g_mrmac/Software/Petalinux/components/yocto/layers/meta-system-controller/conf/machine/vck-sc-zynqmp.conf
```bitbake
#@TYPE: Machine
#@NAME: vck-sc-zynqmp
#@DESCRIPTION: Machine configuration for vck190 and vmk180 system controller.

#### Preamble
MACHINEOVERRIDES =. "${@['', 'vck-sc-zynqmp:']['vck-sc-zynqmp' !='${MACHINE}']}"
#### Regular settings follow

# Variables that changes based on hw design or board specific requirement must be
# defined before calling the required inclusion file else pre-expansion value
# defined in zynqmp-generic.conf will be set.

# Yocto device-tree variables
YAML_CONSOLE_DEVICE_CONFIG:pn-device-tree ?= "psu_uart_0"
YAML_MAIN_MEMORY_CONFIG:pn-device-tree = "PSU_DDR_0"
YAML_DT_BOARD_FLAGS = "{BOARD zynqmp-e-a2197-00-reva}"

# Yocto arm-trusted-firmware(TF-A) variables
ATF_CONSOLE ?= "cadence"
TFA_BL33_LOAD ?= "0x8000000"

# Yocto PMUFW variables
YAML_SERIAL_CONSOLE_STDIN:pn-pmu-firmware ?= "psu_uart_0"
YAML_SERIAL_CONSOLE_STDOUT:pn-pmu-firmware ?= "psu_uart_0"

# Yocto FSBL variables
YAML_SERIAL_CONSOLE_STDIN:pn-fsbl-firmware ?= "psu_uart_0"
YAML_SERIAL_CONSOLE_STDOUT:pn-fsbl-firmware ?= "psu_uart_0"

# Yocto KERNEL Variables
UBOOT_ENTRYPOINT  ?= "0x200000"
UBOOT_LOADADDRESS ?= "0x200000"

# vck-sc-zynqmp Serial Console
SERIAL_CONSOLES ?= "115200;ttyPS0"
YAML_SERIAL_CONSOLE_BAUDRATE ?= "115200"

# Required generic machine inclusion
# Eval board VCK SC uses ZynqMP EG device hence use soc variant based generic machine
# inclusion
require conf/machine/zynqmp-eg-generic.conf

# This eval board sc machine conf file uses eval-brd-sc xsa as reference input.
# User can override with vck-sc custom xsa using HDF_BASE and HDF_PATH variables
# from local.conf.
HDF_MACHINE = "vck-sc-zynqmp"

#### No additional settings should be after the Postamble
#### Postamble
PACKAGE_EXTRA_ARCHS:append = "${@['', ' vck_sc_zynqmp']['vck-sc-zynqmp' != '${MACHINE}']}"
```
